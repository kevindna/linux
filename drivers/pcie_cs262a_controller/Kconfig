## drivers/pcie_cs262a_controller/Kconfig
```kconfig
config PCIE_CS262A
	bool "CS262A Root complex model support"
	depends on OF || COMPILE_TEST
	help
	  Say 'Y' here if you want kernel to support the best CS262A
	  Host Bridge driver.
```
